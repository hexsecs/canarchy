VERSION ""

NS_ :

BS_:

BU_: ECU

BO_ 256 CyclicMsg: 2 ECU
 SG_ CyclicCounter : 0|16@1+ (1,0) [0|65535] "" ECU

BO_ 1024 EventMsg: 1 ECU
 SG_ EventState : 0|8@1+ (1,0) [0|255] "" ECU

BA_DEF_ BO_ "GenMsgCycleTime" INT 0 10000;
BA_DEF_ BO_ "GenMsgSendType" ENUM "cyclic","event","ifActive","noMsgSendType";
BA_DEF_DEF_ "GenMsgCycleTime" 0;
BA_DEF_DEF_ "GenMsgSendType" "noMsgSendType";
BA_ "GenMsgCycleTime" BO_ 256 100;
BA_ "GenMsgSendType" BO_ 256 0;
BA_ "GenMsgSendType" BO_ 1024 1;
