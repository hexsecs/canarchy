VERSION ""

NS_ :

BS_:

BU_: Vector__XXX

BA_DEF_ SG_  "SPN" INT 0 524287;

BO_ 2565866545 OemEngineMessage: 8 Vector__XXX
 SG_ OemBoostPressure : 8|16@1+ (0.25,-50) [0|16000] "kPa" Vector__XXX

BA_ "SPN" SG_ 2565866545 OemBoostPressure 9999;
