AUTOSAR XML (schema 4-2-2)
package /Cluster
  can cluster CanCluster
    can physical channel CanChannel
      frame EngineStatus1: id 0x18FEF431, frame-length=4, can-addressing-mode=EXTENDED, can-frame-rx-behavior=CAN-20, can-frame-tx-behavior=CAN-20
        pdu EngineStatus1_Pdu: length=4
          signal CoolantTemp: start 0, 8 bit, little-endian
          signal OilTemp: start 8, 8 bit, little-endian
